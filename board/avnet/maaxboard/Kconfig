## board/avnet/maaxboard/Kconfig
```kconfig
if TARGET_MAAXBOARD

config SYS_BOARD
	default "maaxboard"

config SYS_VENDOR
	default "avnet"

config SYS_CONFIG_NAME
	default "maaxboard"

config IMX_CONFIG
	default "arch/arm/mach-imx/imx8m/imximage.cfg"

endif
```

## board/avnet/maaxboard_8ulp/Kconfig
```kconfig
if TARGET_MAAXBOARD_8ULP

config SYS_BOARD
	default "maaxboard_8ulp"

config SYS_VENDOR
	default "avnet"

config SYS_CONFIG_NAME
	default "maaxboard_8ulp"

endif
```

## board/avnet/maaxboard_mini/Kconfig
```kconfig
if TARGET_MAAXBOARD_MINI

config SYS_BOARD
	default "maaxboard_mini"

config SYS_VENDOR
	default "avnet"

config SYS_CONFIG_NAME
	default "maaxboard_mini"

config IMX_CONFIG
	default "board/freescale/imx8mm_evk/imximage-8mm.cfg"

source "board/freescale/common/Kconfig"

endif
```

## board/avnet/maaxboard_nano/Kconfig
```kconfig
if TARGET_MAAXBOARD_NANO

config SYS_BOARD
	default "maaxboard_nano"

config SYS_VENDOR
	default "avnet"

config SYS_CONFIG_NAME
	default "maaxboard_nano"

config IMX8MN_LOW_DRIVE_MODE
	bool "Enable the low dirive mode of maaxboard_nano"
	default n

source "board/freescale/common/Kconfig"

endif
```

## board/avnet/maaxboard_osm93/Kconfig
```kconfig
if TARGET_MAAXBOARD_OSM93

config SYS_BOARD
	default "maaxboard_osm93"

config SYS_VENDOR
	default "avnet"

config SYS_CONFIG_NAME
	default "maaxboard_osm93"

config IMX93_EVK_LPDDR4X
	bool "Using LPDDR4X Timing and PMIC voltage"
	default y
	select IMX9_LPDDR4X
	help
	  Select the LPDDR4X timing and 0.6V VDDQ

endif
```

## board/embest/em_sbc_imx8m/Kconfig
```kconfig
if TARGET_EM_SBC_IMX8M

config SYS_BOARD
	default "em_sbc_imx8m"

config SYS_VENDOR
	default "embest"

config SYS_CONFIG_NAME
	default "em_sbc_imx8m"

source "board/freescale/common/Kconfig"

endif
```

## board/embest/maaxboard/Kconfig
```kconfig
if TARGET_MAAXBOARD

config SYS_BOARD
	default "maaxboard"

config SYS_VENDOR
	default "embest"

config SYS_CONFIG_NAME
	default "maaxboard"

source "board/freescale/common/Kconfig"

endif
```

## board/embest/maaxboard_mini/Kconfig
```kconfig
if TARGET_MAAXBOARD_MINI

config SYS_BOARD
	default "maaxboard_mini"

config SYS_VENDOR
	default "embest"

config SYS_CONFIG_NAME
	default "maaxboard_mini"

source "board/freescale/common/Kconfig"

endif
```

## board/embest/maaxboard_nano/Kconfig
```kconfig
if TARGET_MAAXBOARD_NANO

config SYS_BOARD
	default "maaxboard_nano"

config SYS_VENDOR
	default "embest"

config SYS_CONFIG_NAME
	default "maaxboard_nano"

source "board/freescale/common/Kconfig"

endif
```

## board/freescale/maaxboard_nano/Kconfig
```kconfig
if TARGET_MAAXBOARD_NANO

config SYS_BOARD
	default "maaxboard_nano"

config SYS_VENDOR
	default "freescale"

config SYS_CONFIG_NAME
	default "maaxboard_nano"

source "board/freescale/common/Kconfig"

endif
```
